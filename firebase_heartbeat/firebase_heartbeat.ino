#include <ESP8266WiFi.h>
#include <FirebaseArduino.h>
#include "IRremoteESP8266.h"
#include <ESP8266WiFi.h>
#include <Ticker.h>
#include <Wire.h>  // Only needed for Arduino 1.6.5 and earlier
#include "SSD1306.h"
//#include "main.cpp"
int RECV_PIN = D4;


// Created by http://oleddisplay.squix.ch/ Consider a donation
// In case of problems make sure that you are using the font file with the correct version!
const char Roboto_16[] PROGMEM = {
  0x0F, // Width: 15
  0x13, // Height: 19
  0x20, // First Char: 32
  0xE0, // Numbers of Chars: 224

  // Jump Table:
  0xFF, 0xFF, 0x00, 0x04,  // 32:65535
  0x00, 0x00, 0x05, 0x03,  // 33:0
  0x00, 0x05, 0x0A, 0x05,  // 34:5
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  0x11, 0xE0, 0x16, 0x08,  // 255:4576

  // Font Data:
  0x00,0x00,0x00,0xF8,0x47, // 33
  0x00,0x00,0x00,0x78,0x00,0x00,0x00,0x00,0x00,0x78,  // 34
  0x00,0x00,0x00,0x00,0x08,0x00,0x40,0x08,0x00,0x40,0x7C,0x00,0xF0,0x0B,0x00,0x48,0x08,0x00,0x40,0x7C,0x00,0xF8,0x0B,0x00,0x48,0x08,0x00,0x40,  // 35
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  0x00,0x00,0x00,0xC0,0x01,0x02,0x88,0x07,0x02,0x00,0xBC,0x01,0x00,0xF0,0x00,0x00,0x1E,0x00,0xC8,0x03,0x00,0x40 // 255
};



IRrecv irrecv(RECV_PIN);
decode_results results;

// Config Firebase
#define FIREBASE_HOST "testir-5e0f2.firebaseio.com"
#define FIREBASE_AUTH "zN9Dka8tSRzWXXU228GGXKrC7II5cXJ4WsMvnOKg"

// Config connect WiFi
#define WIFI_SSID "Banklvp"
#define WIFI_PASSWORD "1928374655"

int i = 0;
int a = 000;

const int httpPort = 80;
Ticker sender;
const char* ssid = "Banklvp";
const char* password = "1928374655";
WiFiClient client;
const char* host = "192.168.1.1";//you pc IP

///
volatile boolean firstBeat = true;        // used to seed rate array so we startup with reasonable BPM
volatile boolean secondBeat = true;       // used to seed rate array so we startup with reasonable BPM
volatile int P =512;                      // used to find peak in pulse wave
volatile int T = 512;                     // used to find trough in pulse wave
volatile int amp = 100;                   // used to hold amplitude of pulse waveform
const int maxAvgSample = 20;
volatile int rate[maxAvgSample];                    // used to hold last ten IBI values
boolean sendok = false;
volatile unsigned long sampleCounter = 0;          // used to determine pulse timing
volatile unsigned long lastBeatTime = 0;           // used to find the inter beat interval
volatile int BPM;                   // used to hold the pulse rate
volatile int Signal;                // holds the incoming raw data
volatile int IBI = 600;             // holds the time between beats, the Inter-Beat Interval
volatile int thresh = 512;                // used to find instant moment of heart beat
volatile boolean Pulse = false;     // true when pulse wave is high, false when it's low
volatile boolean QS = false;
Ticker flipper;
///

SSD1306  display(0x3c, D3, D5);

void setup() {
  Serial.begin(115200);

  WiFi.mode(WIFI_STA);
  WiFi.begin(WIFI_SSID, WIFI_PASSWORD);
  Serial.print("connecting");

  while (WiFi.status() != WL_CONNECTED) {
    Serial.print(".");
    delay(500);
  }
  Serial.println();
  Serial.print("connected: ");
  Serial.println(WiFi.localIP());


  display.init();
display.flipScreenVertically();
display.setContrast(255);

  // Firebase.begin(FIREBASE_HOST, FIREBASE_AUTH);
  // irrecv.enableIRIn(); // Start the receiver
   // delay(10);

  // Serial.print("Connecting to ");
  // Serial.println(ssid);
  // WiFi.begin(ssid, password);
  // while (WiFi.status() != WL_CONNECTED) {
    // delay(500);
    // Serial.print(".");
  // }

  // Serial.println("");
  // Serial.println("WiFi connected");
  // Serial.println("IP address: ");
  // Serial.println(WiFi.localIP());
  // Serial.print("connecting to ");
  // Serial.println(host);


  // if (!client.connect(host, httpPort)) {
  //   Serial.println("connection failed1");
  //   return;
  // }

  // client.print("255");
  // delay(10);


  // Serial.println("end Setup");
  flipper.attach_ms(2, Test);
  // sender.attach(2, senderfunc);

  delay(2000);
}

void senderfunc()
{
  sendok=true;
}

void loop() {
  // Firebase.setInt("number", i);
  // Firebase.setInt("status", a);
  // if (Firebase.failed()) {
  //     Serial.print("set /number failed:");
  //     Serial.println(Firebase.error());
  //     return;
  // }
  //   else  Serial.print("number to ");
  //       Serial.println(Firebase.getInt("number"));
  //
  //       if (irrecv.decode(&results)) {
  //          Serial.println("Someone is going out from the house");
  //          a = 111;
  //          //Serial.println(Firebase.getInt("status"));
  //          //Serial.println(results.value, HEX);
  //          irrecv.resume(); // Receive the next value
  //        }
  //       else  {Serial.println("Still in the house");
  //             a = 000;
  //
  //       }Serial.println(a);
  // i++;
  if(sendok)
     {
        delay(10);
            // WiFiClient client;
            //   const int httpPort = 80;// to port to send the data
            //   if (!client.connect(host, httpPort)) {
            //     Serial.println("connection failed2");
            //     return;
            //   }

              //Serial.print("Requesting URL: ");

              // This will send the request to the server
            //   client.print(BPM);
              Serial.println(BPM);
              delay(100);
              sendok =false;
              flipper.attach_ms(2, Test);
     }

//////Screen
display.clear();
   display.setFont(Roboto_16);
   display.setTextAlignment(TEXT_ALIGN_CENTER_BOTH);
   display.drawString(DISPLAY_WIDTH/2, DISPLAY_HEIGHT/2 - 10, "Heart Rate : "+ String(BPM)+"\n"+getTime());
//   display.drawString(0, 0, "Heart Rate : "+ String(BPM)+"\n"+getTime()+"\nHello Puri");
   display.display();

//   Serial.println(getTime());

//////////

  // Firebase.setInt("HB", BPM);
  delay(1000);
}

void sendtcp()
{


}

String getTimeAndDate() {
  WiFiClient client;
  while (!!!client.connect("google.com", 80)) {
    Serial.println("connection failed, retrying...");
  }

  client.print("HEAD / HTTP/1.1\r\n\r\n");
  while(!!!client.available()) {
     yield();
  }

  while(client.available()){
    if (client.read() == '\n') {
      if (client.read() == 'D') {
        if (client.read() == 'a') {
          if (client.read() == 't') {
            if (client.read() == 'e') {
              if (client.read() == ':') {
                client.read();
                String theDate = client.readStringUntil('\r');
                client.stop();
                return theDate;
              }
            }
          }
        }
      }
    }
  }
}

String getTime(){

  String datetime = getTimeAndDate();
  String engtime = datetime.substring(17,25);

  String engtimearr[3];
  String hours = "00";
  hours[0] = engtime[0];
  hours[1] = engtime[1];
  
  engtimearr[0] = String(hours.toInt()+7);
  engtimearr[1] = engtime.substring(3,5);
  engtimearr[2] = engtime.substring(6,8);

  return engtimearr[0]+":"+engtimearr[1]+":"+engtimearr[2];
  
  }



int count = 0;
void Test(){
  count++;
  if(count ==1000)
  {
    flipper.detach();
    count =0;
    //sendtcp();
    sendok=true;

  }

      Signal = analogRead(A0);              // read the Pulse Sensor
        sampleCounter += 2;                         // keep track of the time in mS with this variable
    int N = sampleCounter - lastBeatTime;       // monitor the time since the last beat to avoid noise

      if(Signal < thresh && N > (IBI/5)*3){       // avoid dichrotic noise by waiting 3/5 of last IBI
        if (Signal < T){                        // T is the trough
            T = Signal;                         // keep track of lowest point in pulse wave
         }
       }

    if(Signal > thresh && Signal > P){          // thresh condition helps avoid noise
        P = Signal;                             // P is the peak
       }                                        // keep track of highest point in pulse wave

  //  NOW IT'S TIME TO LOOK FOR THE HEART BEAT
  // signal surges up in value every time there is a pulse
if (N > 250){                                   // avoid high frequency noise
  if ( (Signal > thresh) && (Pulse == false) && (N > (IBI/5)*3) ){
    Pulse = true;                               // set the Pulse flag when we think there is a pulse
    //digitalWrite(blinkPin,HIGH);                // turn on pin 13 LED
    IBI = sampleCounter - lastBeatTime;         // measure time between beats in mS
    lastBeatTime = sampleCounter;               // keep track of time for next pulse

         if(firstBeat){                         // if it's the first time we found a beat, if firstBeat == TRUE
             firstBeat = false;                 // clear firstBeat flag
             return;                            // IBI value is unreliable so discard it
            }
         if(secondBeat){                        // if this is the second beat, if secondBeat == TRUE
            secondBeat = false;                 // clear secondBeat flag
               for(int i=0; i<=maxAvgSample-1; i++){         // seed the running total to get a realisitic BPM at startup
                    rate[i] = IBI;
                    }
            }

    // keep a running total of the last 10 IBI values
    word runningTotal = 0;                   // clear the runningTotal variable

    for(int i=0; i<=(maxAvgSample-2); i++){                // shift data in the rate array
          rate[i] = rate[i+1];              // and drop the oldest IBI value
          runningTotal += rate[i];          // add up the 9 oldest IBI values
        }

    rate[maxAvgSample-1] = IBI;                          // add the latest IBI to the rate array
    runningTotal += rate[maxAvgSample-1];                // add the latest IBI to runningTotal
    runningTotal /= maxAvgSample;                     // average the last 10 IBI values
    BPM = 60000/runningTotal;               // how many beats can fit into a minute? that's BPM!
    QS = true;                              // set Quantified Self flag
    // QS FLAG IS NOT CLEARED INSIDE THIS ISR
    }
}

  if (Signal < thresh && Pulse == true){     // when the values are going down, the beat is over
      //digitalWrite(blinkPin,LOW);            // turn off pin 13 LED
      Pulse = false;                         // reset the Pulse flag so we can do it again
      amp = P - T;                           // get amplitude of the pulse wave
      thresh = amp/2 + T;                    // set thresh at 50% of the amplitude
      P = thresh;                            // reset these for next time
      T = thresh;
     }

  if (N > 2500){                             // if 2.5 seconds go by without a beat
      thresh = 512;                          // set thresh default
      P = 512;                               // set P default
      T = 512;                               // set T default
      lastBeatTime = sampleCounter;          // bring the lastBeatTime up to date
      firstBeat = true;                      // set these to avoid noise
      secondBeat = true;                     // when we get the heartbeat back
     }

  //sei();                                     // enable interrupts when youre done!
}// end isr

